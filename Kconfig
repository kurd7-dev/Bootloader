## Kconfig
```kconfig
menu "Bootloader configuration"

choice
    prompt "Target board"
    default TARGET_QEMU_VIRT

config TARGET_QEMU_VIRT
    bool "QEMU virt (AArch64)"

config TARGET_RPI3
    bool "Raspberry Pi 3 (AArch64)"

endchoice

config BOOTLOADER_BASE
    hex "Bootloader link address"
    default 0x40000000 if TARGET_QEMU_VIRT
    default 0x00080000 if TARGET_RPI3

config KERNEL_RUNTIME_ADDR
    hex "Kernel runtime load address"
    default 0x52000000 if TARGET_QEMU_VIRT
    default 0x00280000 if TARGET_RPI3

config DTB_FALLBACK_ADDR
    hex "Fallback DTB address"
    default 0x42000000 if TARGET_QEMU_VIRT
    default 0x02600000 if TARGET_RPI3

config UART_BASE
    hex "PL011 UART base"
    default 0x09000000 if TARGET_QEMU_VIRT
    default 0x3F201000 if TARGET_RPI3

config UART_CLOCK_HZ
    int "PL011 UART clock"
    default 24000000 if TARGET_QEMU_VIRT
    default 48000000 if TARGET_RPI3

config PERIPH_BASE
    hex "Peripheral base"
    default 0x00000000 if TARGET_QEMU_VIRT
    default 0x3F000000 if TARGET_RPI3

config OUTPUT_IMAGE
    string "Output image filename"
    default "bootloader.bin" if TARGET_QEMU_VIRT
    default "kernel8.img" if TARGET_RPI3

config DEFAULT_BOOTARGS
    string "Default bootargs"
    default "console=ttyAMA0,115200 earlycon=pl011,0x09000000 loglevel=8 ignore_loglevel panic=3 oops=panic" if TARGET_QEMU_VIRT
    default "console=ttyAMA0,115200 earlycon loglevel=8 panic=3" if TARGET_RPI3

config ENABLE_QEMU_RUN_TARGET
    bool "Enable make run for QEMU"
    default y if TARGET_QEMU_VIRT
    default n if TARGET_RPI3

endmenu
```

## configs/generic_arm64_defconfig
```kconfig
CONFIG_ARM=y
CONFIG_ARM64=y
CONFIG_ARCH_UNSPECIFIED=y
CONFIG_SYS_TEXT_BASE=0x80000000

# Boot configuration
CONFIG_SPL=y
CONFIG_SPL_SERIAL=y
CONFIG_SPL_SYS_MALLOC_F_LEN=0x4000
CONFIG_SYS_SPL_MALLOC_SIZE=0x4000

# Storage
CONFIG_MMC=y
CONFIG_MMC_WRITE=y
CONFIG_MMC_SDHCI=y
CONFIG_MMC_SDHCI_ARASAN=y
CONFIG_SPL_MMC=y
CONFIG_SPL_FAT=y
CONFIG_SPL_FAT_WRITE=y

# Filesystems
CONFIG_FAT_WRITE=y
CONFIG_FS_FAT=y

# Shell and commands
CONFIG_CMDLINE=y
CONFIG_CMD_BOOTM=y
CONFIG_CMD_LOAD=y
CONFIG_CMD_MEMORY=y
CONFIG_CMD_SETEXPR=y
CONFIG_CMD_FAT=y

# Device tree
CONFIG_OF_LIBFDT=y
CONFIG_OF_CONTROL=y
CONFIG_OF_SEPARATE=y

# Serial
CONFIG_PL011_SERIAL=y
CONFIG_SYS_NS16550=y

# Android
CONFIG_ANDROID_BOOT_IMAGE=y
CONFIG_CMD_ABOOTIMG=y

# Debug
CONFIG_DEBUG_UART=y
```

## configs/qemu_virt_defconfig
```kconfig
CONFIG_TARGET_QEMU_VIRT=y
CONFIG_BOOTLOADER_BASE=0x40000000
CONFIG_KERNEL_RUNTIME_ADDR=0x52000000
CONFIG_DTB_FALLBACK_ADDR=0x42000000
CONFIG_UART_BASE=0x09000000
CONFIG_UART_CLOCK_HZ=24000000
CONFIG_PERIPH_BASE=0x00000000
CONFIG_OUTPUT_IMAGE="bootloader.bin"
CONFIG_DEFAULT_BOOTARGS="console=ttyAMA0,115200 earlycon=pl011,0x09000000 loglevel=8 ignore_loglevel panic=3 oops=panic"
CONFIG_ENABLE_QEMU_RUN_TARGET=y
```

## configs/rpi3_defconfig
```kconfig
CONFIG_TARGET_RPI3=y
CONFIG_BOOTLOADER_BASE=0x00080000
CONFIG_KERNEL_RUNTIME_ADDR=0x00280000
CONFIG_DTB_FALLBACK_ADDR=0x02600000
CONFIG_UART_BASE=0x3F201000
CONFIG_UART_CLOCK_HZ=48000000
CONFIG_PERIPH_BASE=0x3F000000
CONFIG_OUTPUT_IMAGE="kernel8.img"
CONFIG_DEFAULT_BOOTARGS="console=ttyAMA0,115200 earlycon loglevel=8 panic=3"
CONFIG_ENABLE_QEMU_RUN_TARGET=n
```
